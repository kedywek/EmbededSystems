# file: DisplayCounter.ioc
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Mcu.Family=STM32L4
Mcu.Name=STM32L496Z(E-G)Tx
Mcu.Package=LQFP144
NVIC.PriorityGroup=NVIC_PRIORITYGROUP_4
ProjectManager.HeapSize=0x200
ProjectManager.StackSize=0x400
ProjectManager.TargetToolchain=STM32CubeIDE
RCC.HSE_VALUE=8000000
RCC.HSI48_VALUE=48000000
RCC.HSI_VALUE=16000000
RCC.LSE_VALUE=32768
RCC.MSI_VALUE=4000000
RCC.VCOOutputFreq_Value=32000000
board=custom

// file: Core/Src/main.c
/* USER CODE BEGIN Header */
/**
  ******************************************************************************
  * @file           : main.c
  * @brief          : Main program body
  ******************************************************************************
  * @attention
  *
  * <h2><center>&copy; Copyright (c) 2020 STMicroelectronics.
  * All rights reserved.</center></h2>
  *
  * This software component is licensed by ST under BSD 3-Clause license,
  * the "License"; You may not use this file except in compliance with the
  * License. You may obtain a copy of the License at:
  *                        opensource.org/licenses/BSD-3-Clause
  *
  ******************************************************************************
  */
/* USER CODE END Header */

#include "main.h"

/* USER CODE BEGIN PD */
#define INTERVAL 1000
#define ON GPIO_PIN_SET
#define OFF GPIO_PIN_RESET

#define MAX_DIGIT 9
#define MIN_DIGIT 0

#define NUMBER_OF_SEGMENTS 7
#define NUMBER_OF_DIGITS 4

#define DIGIT_1 GPIO_PIN_2
#define DIGIT_2	GPIO_PIN_3
#define DIGIT_3 GPIO_PIN_4
#define DIGIT_4 GPIO_PIN_5

#define DIGIT_PORT GPIOB

#define SEGMENT_A GPIO_PIN_0
#define SEGMENT_B GPIO_PIN_1
#define SEGMENT_C GPIO_PIN_2
#define SEGMENT_D GPIO_PIN_3
#define SEGMENT_E GPIO_PIN_4
#define SEGMENT_F GPIO_PIN_5
#define SEGMENT_G GPIO_PIN_6

#define SEGMENT_PORT GPIOG

#define JOYSTICK_PUSHED_PIN GPIO_PIN_15

#define JOYSTICK_PORT GPIOE

/* USER CODE END PD */

void SystemClock_Config(void);
void initializeClocks(void);
void initializationOfSegments(void);
void initializationOfDigit(void);
void initializationOfJoystick(void);

/* USER CODE BEGIN PFP */
void initliazePinToOutput(GPIO_TypeDef *port, int pin);
void initliazePinToInput(GPIO_TypeDef *port, int pin);
/* USER CODE END PFP */

/* USER CODE BEGIN 0 */
const int SEGMENTS_PINS[7] = {SEGMENT_A, SEGMENT_B, SEGMENT_C, SEGMENT_D, SEGMENT_E, SEGMENT_F, SEGMENT_G};
const int DIGITS_PINS[4] = {DIGIT_1, DIGIT_2, DIGIT_3, DIGIT_4};
const uint8_t digit_patterns[10] = {
    0b0111111,
    0b0000110,
    0b1011011,
    0b1001111,
    0b1100110,
    0b1101101,
    0b1111101,
    0b0000111,
    0b1111111,
    0b1101111
};
/* USER CODE END 0 */

int main(void)
{

  /* MCU Configuration--------------------------------------------------------*/

  /* Reset of all peripherals, Initializes the Flash interface and the Systick. */
  HAL_Init();

  /* Configure the system clock */
  SystemClock_Config();

  /* Initialize all configured peripherals */
  initializeClocks();
  initializationOfSegments();
  initializationOfDigit();
  initializationOfJoystick();

  /* Infinite loop */
  /* USER CODE BEGIN WHILE */
  int counter = 0;  // Counter value
  int direction = 1;  // 1 for up, -1 for down

  /* Function prototypes */
  void updateDisplay(int num);

  while (1)
  {

	  /* USER CODE END WHILE */
	  /* USER CODE BEGIN 3 */
	  updateDisplay(counter);
	  HAL_Delay(INTERVAL);
	  if (HAL_GPIO_ReadPin(JOYSTICK_PORT, JOYSTICK_PUSHED_PIN)){
		  direction = 1;
	  }
	  else{
		  direction = -1;
	  }
	  counter += direction;
	  if (counter > MAX_DIGIT) counter = MIN_DIGIT;
	  if (counter < MIN_DIGIT) counter = MAX_DIGIT;
  }
  /* USER CODE END 3 */
}

void SystemClock_Config(void)
{
  RCC_OscInitTypeDef RCC_OscInitStruct = {0};
  RCC_ClkInitTypeDef RCC_ClkInitStruct = {0};

  /** Initializes the CPU, AHB and APB busses clocks
  */
  RCC_OscInitStruct.OscillatorType = RCC_OSCILLATORTYPE_MSI;
  RCC_OscInitStruct.MSIState = RCC_MSI_ON;
  RCC_OscInitStruct.MSICalibrationValue = 0;
  RCC_OscInitStruct.MSIClockRange = RCC_MSIRANGE_6;
  RCC_OscInitStruct.PLL.PLLState = RCC_PLL_NONE;
  if (HAL_RCC_OscConfig(&RCC_OscInitStruct) != HAL_OK)
  {
    Error_Handler();
  }
  /** Initializes the CPU, AHB and APB busses clocks
  */
  RCC_ClkInitStruct.ClockType = RCC_CLOCKTYPE_HCLK|RCC_CLOCKTYPE_SYSCLK
                              |RCC_CLOCKTYPE_PCLK1|RCC_CLOCKTYPE_PCLK2;
  RCC_ClkInitStruct.SYSCLKSource = RCC_SYSCLKSOURCE_MSI;
  RCC_ClkInitStruct.AHBCLKDivider = RCC_SYSCLK_DIV1;
  RCC_ClkInitStruct.APB1CLKDivider = RCC_HCLK_DIV1;
  RCC_ClkInitStruct.APB2CLKDivider = RCC_HCLK_DIV1;

  if (HAL_RCC_ClockConfig(&RCC_ClkInitStruct, FLASH_LATENCY_0) != HAL_OK)
  {
    Error_Handler();
  }
  /** Configure the main internal regulator output voltage
  */
  if (HAL_PWREx_ControlVoltageScaling(PWR_REGULATOR_VOLTAGE_SCALE1) != HAL_OK)
  {
    Error_Handler();
  }
}

/* USER CODE BEGIN 4 */
void updateDisplay(int num)
{
    uint8_t pattern = digit_patterns[num];
    HAL_GPIO_WritePin(SEGMENT_PORT, SEGMENT_A, (pattern & 0b0000001) ? GPIO_PIN_SET : GPIO_PIN_RESET);
    HAL_GPIO_WritePin(SEGMENT_PORT, SEGMENT_B, (pattern & 0b0000010) ? GPIO_PIN_SET : GPIO_PIN_RESET);
    HAL_GPIO_WritePin(SEGMENT_PORT, SEGMENT_C, (pattern & 0b0000100) ? GPIO_PIN_SET : GPIO_PIN_RESET);
    HAL_GPIO_WritePin(SEGMENT_PORT, SEGMENT_D, (pattern & 0b0001000) ? GPIO_PIN_SET : GPIO_PIN_RESET);
    HAL_GPIO_WritePin(SEGMENT_PORT, SEGMENT_E, (pattern & 0b0010000) ? GPIO_PIN_SET : GPIO_PIN_RESET);
    HAL_GPIO_WritePin(SEGMENT_PORT, SEGMENT_F, (pattern & 0b0100000) ? GPIO_PIN_SET : GPIO_PIN_RESET);
    HAL_GPIO_WritePin(SEGMENT_PORT, SEGMENT_G, (pattern & 0b1000000) ? GPIO_PIN_SET : GPIO_PIN_RESET);
}

void initializeClocks(void){
	__HAL_RCC_GPIOB_CLK_ENABLE();
	__HAL_RCC_GPIOE_CLK_ENABLE();
	__HAL_RCC_GPIOG_CLK_ENABLE();
}

void initializationOfJoystick(void)
{
	initliazePinToInput(JOYSTICK_PORT, JOYSTICK_PUSHED_PIN);
}
void initializationOfDigit(void)
{
	for(int i = 0; i < NUMBER_OF_SEGMENTS; i++){
		initliazePinToOutput(DIGIT_PORT, DIGITS_PINS[i]);
	}
	HAL_GPIO_WritePin(DIGIT_PORT, DIGIT_2, ON);
}
void initializationOfSegments(void){
	HAL_PWREx_EnableVddIO2();
	for(int i = 0; i < NUMBER_OF_SEGMENTS; i++){
		initliazePinToOutput(SEGMENT_PORT, SEGMENTS_PINS[i]);
	}
}

void initliazePinToOutput(GPIO_TypeDef *port, int pin){
	GPIO_InitTypeDef GPIO_InitStruct = {0};
	HAL_GPIO_WritePin(port, pin, OFF);
	GPIO_InitStruct.Pin = pin;
	GPIO_InitStruct.Mode = GPIO_MODE_OUTPUT_PP;
	GPIO_InitStruct.Pull = GPIO_NOPULL;
	GPIO_InitStruct.Speed = GPIO_SPEED_FREQ_LOW;

	HAL_GPIO_Init(port, &GPIO_InitStruct);
}

void initliazePinToInput(GPIO_TypeDef *port, int pin){
	GPIO_InitTypeDef GPIO_InitStruct = {0};
	HAL_GPIO_WritePin(port, pin, OFF);
	GPIO_InitStruct.Pin = pin;
	GPIO_InitStruct.Mode = GPIO_MODE_INPUT;
	GPIO_InitStruct.Pull = GPIO_PULLDOWN;
	GPIO_InitStruct.Speed = GPIO_SPEED_FREQ_LOW;

	HAL_GPIO_Init(port, &GPIO_InitStruct);
}

/* USER CODE END 4 */

void Error_Handler(void)
{
}

#ifdef  USE_FULL_ASSERT
/**
  * @brief  Reports the name of the source file and the source line number
  *         where the assert_param error has occurred.
  * @param  file: pointer to the source file name
  * @param  line: assert_param error line source number
  * @retval None
  */
void assert_failed(char *file, uint32_t line)
{
  /* USER CODE BEGIN 6 */
	while(1);
  /* User can add his own implementation to report the file name and line number,
     tex: printf("Wrong parameters value: file %s on line %d\r\n", file, line) */
  /* USER CODE END 6 */
}
#endif /* USE_FULL_ASSERT */

/************************ (C) COPYRIGHT STMicroelectronics *****END OF FILE****/
